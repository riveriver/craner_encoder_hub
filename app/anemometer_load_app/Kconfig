## app/anemometer_load_app/Kconfig
```kconfig
config ENABLE_ANEMOMETER_SENSOR
	bool "Enable anemometer application"
	default y
	help
	  Enable the combined anemometer and load ADC Modbus application.

config ANEMOMETER_IFACE_NAME
	string "Anemometer RS485 interface name"
	default "rs485-usart6"

config ANEMOMETER_MODBUS_UNIT_ID
	int "Anemometer Modbus unit id"
	default 1
	range 1 247

config ANEMOMETER_MODBUS_BAUD
	int "Anemometer Modbus baud rate"
	default 9600

config ANEMOMETER_MODBUS_RX_TIMEOUT_MS
	int "Anemometer Modbus RX timeout in milliseconds"
	default 100

config ANEMOMETER_SAMPLE_PERIOD_MS
	int "Anemometer sample period in milliseconds"
	default 1000
	range 100 60000

config ANEMOMETER_MODBUS_START_ADDR
	hex "Anemometer Modbus holding register start address"
	default 0x0009

config ANEMOMETER_MODBUS_REGISTER_COUNT
	int "Anemometer Modbus holding register count"
	default 5
	range 5 5

config ANEMOMETER_THREAD_STACK_SIZE
	int "Combined anemometer/load Modbus thread stack size"
	default 2048
	range 1024 4096

config ANEMOMETER_THREAD_PRIORITY
	int "Combined anemometer/load Modbus thread priority"
	default 6
	range 0 15

config LOAD_ADC_SHELL
	bool "Enable load ADC shell commands"
	default y
	depends on SHELL
```
